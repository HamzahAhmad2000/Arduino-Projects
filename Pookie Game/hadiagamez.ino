#include <Adafruit_NeoPixel.h>

#include <stdio.h>
#include <stdlib.h>
#include<time.h>

#include <Wire.h>
#include <Adafruit_GFX.h>
#include <Adafruit_SSD1306.h>

#define SCREEN_WIDTH 128
#define SCREEN_HEIGHT 64

Adafruit_SSD1306 display(SCREEN_WIDTH, SCREEN_HEIGHT, &Wire, -1);


// 'happy left', 128x64px
static const unsigned char PROGMEM  epd_bitmap_happy_left []  = {
	0x80, 0x00, 0x00, 0x00, 0x00, 0x00, 0x00, 0x00, 0x00, 0x00, 0x00, 0x00, 0x00, 0x00, 0x00, 0x00, 
	0x80, 0x00, 0x00, 0x00, 0x00, 0x00, 0x00, 0x00, 0x00, 0x00, 0x00, 0x00, 0x00, 0x00, 0x00, 0x00, 
	0x80, 0x00, 0x00, 0x00, 0x00, 0x00, 0x00, 0x00, 0x00, 0x00, 0x00, 0x00, 0x00, 0x00, 0x00, 0x00, 
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	0x80, 0x00, 0x00, 0x00, 0x00, 0x00, 0x00, 0x00, 0x00, 0x00, 0x00, 0x00, 0x00, 0x00, 0x00, 0x00
};
// 'happy right', 128x64px
static const unsigned char PROGMEM  epd_bitmap_happy_right []  = {
	0x00, 0x00, 0x00, 0x00, 0x00, 0x00, 0x00, 0x00, 0x00, 0x00, 0x00, 0x00, 0x00, 0x00, 0x00, 0x00, 
	0x00, 0x00, 0x00, 0x00, 0x00, 0x00, 0x00, 0x00, 0x00, 0x00, 0x00, 0x00, 0x00, 0x00, 0x00, 0x00, 
	0x00, 0x00, 0x00, 0x00, 0x00, 0x00, 0x00, 0x00, 0x00, 0x00, 0x00, 0x00, 0x00, 0x00, 0x00, 0x00, 
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	0x00, 0x00, 0x00, 0x00, 0x00, 0x00, 0x00, 0x00, 0x00, 0x00, 0x00, 0x00, 0x00, 0x00, 0x00, 0x00
};
// 'normal left', 128x64px
static const unsigned char PROGMEM  epd_bitmap_normal_left []  = {
	0x00, 0x00, 0x00, 0x00, 0x00, 0x00, 0x00, 0x00, 0x00, 0x00, 0x00, 0x00, 0x00, 0x00, 0x00, 0x00, 
	0x00, 0x00, 0x00, 0x00, 0x00, 0x00, 0x00, 0x00, 0x00, 0x00, 0x00, 0x00, 0x00, 0x00, 0x00, 0x00, 
	0x00, 0x00, 0x00, 0x00, 0x00, 0x00, 0x00, 0x00, 0x00, 0x00, 0x00, 0x00, 0x00, 0x00, 0x00, 0x00, 
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	0x00, 0x00, 0x00, 0x00, 0x00, 0x00, 0x00, 0x00, 0x00, 0x00, 0x00, 0x00, 0x00, 0x00, 0x00, 0x00
};
// 'normal right', 128x64px
static const unsigned char PROGMEM  epd_bitmap_normal_right []  = {
	0x00, 0x00, 0x00, 0x00, 0x00, 0x00, 0x00, 0x00, 0x00, 0x00, 0x00, 0x00, 0x00, 0x00, 0x00, 0x00, 
	0x00, 0x00, 0x00, 0x00, 0x00, 0x00, 0x00, 0x00, 0x00, 0x00, 0x00, 0x00, 0x00, 0x00, 0x00, 0x00, 
	0x00, 0x00, 0x00, 0x00, 0x00, 0x00, 0x00, 0x00, 0x00, 0x00, 0x00, 0x00, 0x00, 0x00, 0x00, 0x00, 
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	0x00, 0x00, 0x00, 0x00, 0x00, 0x00, 0x00, 0x00, 0x00, 0x00, 0x00, 0x00, 0x00, 0x00, 0x00, 0x00
};
// 'sad left', 128x64px
static const unsigned char PROGMEM  epd_bitmap_sad_left []  = {
	0xff, 0xff, 0xff, 0xff, 0xff, 0xff, 0xff, 0xff, 0xff, 0xff, 0xff, 0xff, 0xff, 0xff, 0xff, 0xff, 
	0x00, 0x00, 0x00, 0x00, 0x00, 0x00, 0x00, 0x00, 0x00, 0x00, 0x00, 0x00, 0x00, 0x00, 0x00, 0x00, 
	0x00, 0x00, 0x00, 0x00, 0x00, 0x00, 0x00, 0x00, 0x00, 0x00, 0x00, 0x00, 0x00, 0x00, 0x00, 0x00, 
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	0x00, 0x00, 0x00, 0x00, 0x00, 0x00, 0x00, 0x00, 0x00, 0x00, 0x00, 0x00, 0x00, 0x00, 0x00, 0x00
};
// 'sad right', 128x64px
static const unsigned char PROGMEM  epd_bitmap_sad_right []  = {
	0xff, 0xff, 0xff, 0xff, 0xff, 0xff, 0xff, 0xff, 0xff, 0xff, 0xff, 0xff, 0xff, 0xff, 0xff, 0xff, 
	0x80, 0x00, 0x00, 0x00, 0x00, 0x00, 0x00, 0x00, 0x00, 0x00, 0x00, 0x00, 0x00, 0x00, 0x00, 0x00, 
	0x80, 0x00, 0x00, 0x00, 0x00, 0x00, 0x00, 0x00, 0x00, 0x00, 0x00, 0x00, 0x00, 0x00, 0x00, 0x00, 
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	0x80, 0x00, 0x00, 0x00, 0x00, 0x00, 0x00, 0x00, 0x00, 0x00, 0x00, 0x00, 0x00, 0x00, 0x00, 0x00
};
// 'Sleeo right', 128x64px
static const unsigned char PROGMEM  epd_bitmap_SleeP_right []  = {
	0x80, 0x00, 0x00, 0x00, 0x00, 0x00, 0x00, 0x00, 0x00, 0x00, 0x00, 0x00, 0x00, 0x00, 0x00, 0x00, 
	0x00, 0x00, 0x00, 0x00, 0x00, 0x00, 0x00, 0x00, 0x00, 0x00, 0x00, 0x00, 0x00, 0x00, 0x00, 0x00, 
	0x00, 0x00, 0x00, 0x00, 0x00, 0x00, 0x00, 0x00, 0x00, 0x00, 0x00, 0x00, 0x00, 0x00, 0x00, 0x00, 
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	0x00, 0x00, 0x00, 0x00, 0x00, 0x00, 0x00, 0x00, 0x00, 0x00, 0x00, 0x00, 0x00, 0x00, 0x00, 0x00
};
// 'sleep left', 128x64px
static const unsigned char PROGMEM  epd_bitmap_sleep_left []  = {
	0x00, 0x00, 0x00, 0x00, 0x00, 0x00, 0x00, 0x00, 0x00, 0x00, 0x00, 0x00, 0x00, 0x00, 0x00, 0x00, 
	0x00, 0x00, 0x00, 0x00, 0x00, 0x00, 0x00, 0x00, 0x00, 0x00, 0x00, 0x00, 0x00, 0x00, 0x00, 0x00, 
	0x00, 0x00, 0x00, 0x00, 0x00, 0x00, 0x00, 0x00, 0x00, 0x00, 0x00, 0x00, 0x00, 0x00, 0x00, 0x00, 
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	0x00, 0x00, 0x00, 0x00, 0x00, 0x00, 0x00, 0x00, 0x00, 0x00, 0x00, 0x00, 0x00, 0x00, 0x00, 0x00
};

// Array of all bitmaps for convenience. (Total bytes used to store images in  = 8320)
  
#define NUM_SENSORS 16
#define LEDS_PER_STRIP 144
#define BOX_SIZE 9

#define SENSOR_START_PIN 30
#define SCORE_LED_PIN 49
#define LED_PIN 48

#define BUTTON_PIN_1 22
#define BUTTON_PIN_2 23
#define BUTTON_PIN_3 24

// Create the LED strip objects with adjusted color order
Adafruit_NeoPixel strip = Adafruit_NeoPixel(LEDS_PER_STRIP, LED_PIN, NEO_RGB + NEO_KHZ800);
Adafruit_NeoPixel scoreStrip = Adafruit_NeoPixel(27, SCORE_LED_PIN, NEO_RGB + NEO_KHZ800);

// Score counter
int score = 15;

// State to keep track of which boxes are filled
bool boxFilled[NUM_SENSORS] = {false};

// Define the LED indices for each box
int boxLEDs[NUM_SENSORS][BOX_SIZE] = {
    {0, 1, 2, 12, 13, 14, 24, 25, 26},    // Box 1
    {3, 4, 5, 15, 16, 17, 27, 28, 29},    // Box 2
    {6, 7, 8, 18, 19, 20, 30, 31, 32},    // Box 3
    {9, 10, 11, 21, 22, 23, 33, 34, 35},  // Box 4
    {36, 37, 38, 48, 49, 50, 60, 61, 62}, // Box 5
    {39, 40, 41, 51, 52, 53, 63, 64, 65}, // Box 6
    {42, 43, 44, 54, 55, 56, 66, 67, 68}, // Box 7
    {45, 46, 47, 57, 58, 59, 69, 70, 71}, // Box 8
    {72, 73, 74, 84, 85, 86, 96, 97, 98}, // Box 9
    {75, 76, 77, 87, 88, 89, 99, 100, 101}, // Box 10
    {78, 79, 80, 90, 91, 92, 102, 103, 104}, // Box 11
    {81, 82, 83, 93, 94, 95, 105, 106, 107}, // Box 12
    {108, 109, 110, 120, 121, 122, 132, 133, 134}, // Box 13
    {111, 112, 113, 123, 124, 125, 135, 136, 137}, // Box 14
    {114, 115, 116, 126, 127, 128, 138, 139, 140}, // Box 15
    {117, 118, 119, 129, 130, 131, 141, 142, 143}  // Box 16
};

// Function to turn on a box with a specific color (3x3 section of LEDs)
void turnOnBoxWithColor(int boxIndex) {
    for (int i = 0; i < BOX_SIZE; i++) {
        strip.setPixelColor(boxLEDs[boxIndex][i], strip.Color(255, 0, 0)); // Red
    }
    strip.show();
}

void turnOnBoxWithColor1(int boxIndex) {
    for (int i = 0; i < BOX_SIZE; i++) {
        strip.setPixelColor(boxLEDs[boxIndex][i], strip.Color(122, 20, 0)); // Red
    }
    strip.show();
}

void turnOnBoxWithColor2(int boxIndex) {
    for (int i = 0; i < BOX_SIZE; i++) {
        strip.setPixelColor(boxLEDs[boxIndex][i], strip.Color(18, 20, 140)); // Red
    }
    strip.show();
}

void turnOnBoxWithColor3(int boxIndex) {
    for (int i = 0; i < BOX_SIZE; i++) {
        strip.setPixelColor(boxLEDs[boxIndex][i], strip.Color(60, 120, 110)); // Red
    }
    strip.show();
}

void turnOnBoxWithColor4(int boxIndex) {
    for (int i = 0; i < BOX_SIZE; i++) {
        strip.setPixelColor(boxLEDs[boxIndex][i], strip.Color(255, 54, 20)); // Red
    }
    strip.show();
}






// Function to clear all boxes
void clearAllBoxes() {
    strip.clear();
    strip.show();
}

// Function to update the score LEDs based on the score
void updateScoreLEDs(int score) {
    scoreStrip.clear();
    for (int i = 0; i < score; i++) {
        if (i < 3) {
            // Turn on one LED per score for scores 1 to 3
            scoreStrip.setPixelColor(i, scoreStrip.Color(255, 0, 0)); // Red
        } else {
            // Turn on two LEDs per score for scores 4 to 15
            int index = (i - 3) * 2 + 3;
            if (index < 27) {
                scoreStrip.setPixelColor(index, scoreStrip.Color(255, 0, 0)); // Red
                scoreStrip.setPixelColor(index + 1, scoreStrip.Color(255, 0, 0)); // Red
            }
        }
    }
    scoreStrip.show();
}

void setup() {
    // Initialize serial communication
    Serial.begin(9600);

    // Initialize sensor pins
    for (int i = 0; i < NUM_SENSORS; i++) {
        pinMode(SENSOR_START_PIN + i, INPUT);
    }
    srand(time(0));

    // Initialize button pins
    pinMode(BUTTON_PIN_1, INPUT_PULLUP);
    pinMode(BUTTON_PIN_2, INPUT_PULLUP);
    pinMode(BUTTON_PIN_3, INPUT_PULLUP);

    // Initialize LED strips
    strip.begin();
    strip.show(); // Initialize all pixels to 'off'

    scoreStrip.begin();
    updateScoreLEDs(score);


    if(!display.begin(SSD1306_SWITCHCAPVCC, 0x3C)) {
    Serial.println(F("SSD1306 allocation failed"));
    for(;;);}
    delay(2000); // Pause for 2 seconds

    display.clearDisplay();  // Clear the buffer

// Displays FIRSTarray on the screen
    display.drawBitmap(0, 0, epd_bitmap_normal_left, 128, 64, 1);
    display.display();
}

void loop() {
    static unsigned long lastScoreTime = millis();

    // Check if any button is pressed to start the game
    if (digitalRead(BUTTON_PIN_1) == HIGH) {
      delay(100);
        game1();
        Serial.println(digitalRead(BUTTON_PIN_1));
        delay(100);
    }

    // Decrease score every 1 minute
    if (millis() - lastScoreTime >= 10000) {
        if (score > 0) {
            score--;
            updateScoreLEDs(score);
            Serial.print("Score: ");
            Serial.println(score);
            if (score >5 ){
                 // Pause for 2 seconds

                display.clearDisplay();  // Clear the buffer

              // Displays FIRSTarray on the screen
               display.drawBitmap(0, 0, epd_bitmap_normal_left, 128, 64, 1);
               display.display();
               delay(500);

                 display.clearDisplay();  // Clear the buffer

                // Displays SECONDarray on the screen
                  display.drawBitmap(0, 0, epd_bitmap_normal_right, 128, 64, 1);
                  display.display();
                      if (digitalRead(BUTTON_PIN_1) == HIGH) {
      delay(100);
        game1();
        Serial.println(digitalRead(BUTTON_PIN_1));
        delay(100);
    }

                  delay(500); // Pause for 1.5 seconds
                  display.clearDisplay();  // Clear the buffer

    if (digitalRead(BUTTON_PIN_1) == HIGH) {
      delay(100);
        game1();
        Serial.println(digitalRead(BUTTON_PIN_1));
        delay(100);
    }
                // Displays THIRDarray on the screen
                  display.drawBitmap(0, 0, epd_bitmap_normal_left, 128, 64, 1);
                  display.display();
            }
            else if (score>0){
                              display.clearDisplay();  // Clear the buffer

              // Displays FIRSTarray on the screen
                  if (digitalRead(BUTTON_PIN_1) == HIGH) {
      delay(100);
        game1();
        Serial.println(digitalRead(BUTTON_PIN_1));
        delay(100);
    }
               display.drawBitmap(0, 0, epd_bitmap_sad_left, 128, 64, 1);
               display.display();
               delay(500);

                 display.clearDisplay();  // Clear the buffer

                // Displays SECONDarray on the screen
                  display.drawBitmap(0, 0, epd_bitmap_sad_right, 128, 64, 1);
                  display.display();

                  delay(500); // Pause for 1.5 seconds
                  display.clearDisplay();  // Clear the buffer

                // Displays THIRDarray on the screen
                  display.drawBitmap(0, 0, epd_bitmap_sad_left, 128, 64, 1);
                  display.display();

            }
        }


        lastScoreTime = millis();
    }
}

void game1() {
    bool allBoxesFilled = true;
    static int lastScore = score;
    bool Game = true;
    int filledBox = 0;
    while (Game) {
      
    
        for (int i = 0; i < NUM_SENSORS; i++) {
            if (digitalRead(SENSOR_START_PIN + i) == LOW) {
                Serial.print("Sensor: ");
                Serial.println(i);
                if (!boxFilled[i]) {
                    turnOnBoxWithColor(i); // Red color
                    if (score < 15) {
                        score++;
                        updateScoreLEDs(score);
                    }
                    filledBox++;
                    boxFilled[i] = true;
                }
            }
            allBoxesFilled &= boxFilled[i];
        }

        if (score != lastScore) {
            Serial.print("Score: ");
            Serial.println(score);
            lastScore = score;
        }

        if (filledBox == 16) {
            Game = false;
        }

        delay(100); // Small delay to debounce sensor readings
    }
    clearAllBoxes();
    memset(boxFilled, 0, sizeof(boxFilled));
    delay(2000);
}



void game2() {
  

  for (int j = 0 ; j< 6 ; j++){
  bool game = false;
  int randomNumber = rand() % 15;
  int x = randomNumber;
  turnOnBoxWithColor(randomNumber);


  randomNumber = rand() % 15; 
  turnOnBoxWithColor1(randomNumber);
  randomNumber = rand() % 15; 
  turnOnBoxWithColor2(randomNumber);
  randomNumber = rand() % 15; 
  turnOnBoxWithColor3(randomNumber);
  randomNumber = rand() % 15; 
  turnOnBoxWithColor4(randomNumber);

  

  while (!game) {

        if (digitalRead(BUTTON_PIN_3) == HIGH) {
                      clearAllBoxes();
    memset(boxFilled, 0, sizeof(boxFilled));
        game3();
        return;
    }
    
        if (digitalRead(BUTTON_PIN_1) == HIGH) {
                      clearAllBoxes();
    memset(boxFilled, 0, sizeof(boxFilled));
        game1();
        return;
    }
    for (int i = 0; i < NUM_SENSORS; i++) {
      if (digitalRead(SENSOR_START_PIN + i) == LOW) { 
        if (SENSOR_START_PIN + i==x){// Check the sensor condition
        game = true;
        score++;
        }
      }
    }
  }

  strip.clear();
  strip.show();
  }

}

void game3() {



  int arrtest1[10];
  for (int i = 13; i < 23; i++) {
    strip.setPixelColor(i, strip.Color(255, 0,0));
    
     // Example color
  }

  for (int i = 17; i < 86; i += 12) {
    strip.setPixelColor(i, strip.Color(255, 0, 0)); // Example color
    //strip.setPixelColor(i + 8, strip.Color(255, 0, 0)); // Example color
  }

  for (int i = 61; i < 71; i++) {
    strip.setPixelColor(i, strip.Color(255, 0, 0)); // Example color
  }

  int arr[9] = {1, 2, 3, 4, 6, 9, 10, 11, 12};
  
  bool sensorFilled[9] = {false, false, false, false, false, false, false, false, false};

  int game= 0 ;
  while(!game){
    


        if (digitalRead(BUTTON_PIN_3) == HIGH) {
                      clearAllBoxes();
    memset(boxFilled, 0, sizeof(boxFilled));
        game1();
        return;
    }
    
        if (digitalRead(BUTTON_PIN_1) == HIGH) {
                      clearAllBoxes();
    memset(boxFilled, 0, sizeof(boxFilled));
        game2();
        return;
    }
// Function to check sensors
    bool allFilled = false;

    while (!allFilled) {
        allFilled = true; // Assume all are filled, will check below

        for (int i = 0; i < 9; i++) {
            int sensorPin = SENSOR_START_PIN + arr[i];
            if (digitalRead(sensorPin) == LOW && !sensorFilled[i]) {
                sensorFilled[i] = true;
                Serial.print("Sensor ");
                Serial.print(arr[i]);
                Serial.println(" filled.");

            }
            allFilled &= sensorFilled[i]; // Update allFilled status
        }

        delay(100); // Small delay to debounce sensor readings
    }

    Serial.println("All sensors filled!");



  }
  
  
  for (int i = 49; i < 62; i++) {
    strip.setPixelColor(i, strip.Color(255, 255, 255)); // Example color
  }

  for (int i = 23; i < 71; i += 12) {
    strip.setPixelColor(i, strip.Color(255, 255, 255)); // Example color
     strip.setPixelColor(i-9, strip.Color(255, 255, 255));
  }

  int arr2[10] = {0, 4, 8, 12, 5, 6, 3, 7, 11, 15};
  for (int i = 0; i < 10; i++) {
    strip.setPixelColor(arr2[i], strip.Color(255, 255, 255)); // Example color
  }

  strip.show();
}
